## src/linux/arch/arm/mach-feroceon-kw/Kconfig
```kconfig
if ARCH_FEROCEON_KW

choice
	prompt "Feroceon-KW SoC type"
	default MV88F6281

config  MV88F6281
	bool "88F6281/88F6192/88F6190/88F6180/ SoC"
	---help---
	Choosing this option will generate a linux kernel for the 88F6281/88F6192/88F6190/88F6180 SoC

endchoice

config  OVERRIDE_ETH_CMDLINE
	bool "Override command line definitions for SoC Networking"
	depends on MV88F6281
	---help---
	Choosing this option will override MAC address and MTU definition of kernel command line. 
        The GbE driver will use the setting from kernel config

endif
```

## src/linux/drivers/generic_led/Kconfig
```kconfig
#
# Generic LED control driver
#

menu "Generic LED control driver"
	config GENERIC_LED_CTL
	bool "Generic LED control driver"
	default y
	---help---
	Generic LED control driver.

endmenu
```

## src/linux/drivers/gpio_extender/Kconfig
```kconfig
#
# EXTENDER (I2C) driver configuration
#

menu "GPIO EXTENDER driver"
	config GPIO_EXTENDER
	bool "GPIO extender control driver"
	default y
	---help---
	GPIO extender control driver
endmenu
```
